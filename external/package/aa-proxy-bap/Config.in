## external/package/aa-proxy-bap/Config.in
```kconfig
config BR2_PACKAGE_AA_PROXY_BAP
	bool "aa-proxy-bap"
	depends on BR2_PACKAGE_HOST_RUSTC_TARGET_ARCH_SUPPORTS
	select BR2_PACKAGE_HOST_RUSTC
	help
	  Volkswagen PQ35 BAP CAN cluster integration daemon for aa-proxy-rs.
	  Bridges Android Auto navigation, media, and phone metadata over
	  WebSocket to the Kombiinstrument (MFA+ / Premium) via SocketCAN.

if BR2_PACKAGE_AA_PROXY_BAP

config BR2_PACKAGE_AA_PROXY_BAP_DISPLAY
	bool "Waveshare 4.3\" DSI display (800x480) support"
	default n
	help
	  Enables hardware initialization and vertical MFA simulation output
	  (480x800 portrait) on the Waveshare 4.3" DSI display (/dev/fb0) for
	  Raspberry Pi targets. Disables text terminals (getty on tty1) to
	  ensure a clean graphical presentation.

endif
```
